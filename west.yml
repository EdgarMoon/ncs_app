## west.yml
```yaml
# Copyright (c) 2021 Nordic Semiconductor ASA
# SPDX-License-Identifier: Apache-2.0

manifest:
  self:
    west-commands: scripts/west-commands.yml

  remotes:
    - name: ag
      url-base: https://github.com/EdgarMoon

  projects:
    - name: nrf
      remote: ag
      repo-path: sdk-nrf
      revision: main
      import: true
    - name: mcuboot
      remote: ag
      repo-path: sdk-mcuboot
      revision: main
      path: bootloader/mcuboot
```
